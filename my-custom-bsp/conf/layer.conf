## my-custom-bsp/conf/layer.conf
```bitbake
# ---------------------------------------------------------------------------------------------------------------------
# my-custom-bsp layer for Sokol Linux
# ---------------------------------------------------------------------------------------------------------------------
# This material contains trade secrets or otherwise confidential information owned by Siemens Industry Software Inc.
# or its affiliates (collectively, "SISW"), or its licensors. Access to and use of this information is strictly limited
# as set forth in the Customer's applicable agreements with SISW.
# ---------------------------------------------------------------------------------------------------------------------
# Unpublished work. Copyright 2021 Siemens
# ---------------------------------------------------------------------------------------------------------------------
 
# We have a conf and classes directory, add to BBPATH
BBPATH .= ":${LAYERDIR}"
 
# We have recipes-* directories, add to BBFILES
BBFILES +=  "${LAYERDIR}/recipes-*/*/*.bb ${LAYERDIR}/recipes-*/*/*.bbappend"
 
BBFILE_COLLECTIONS += "my-custom-bsp"
BBFILE_PATTERN_my-custom-bsp = "^${LAYERDIR}/"
BBFILE_PRIORITY_my-custom-bsp = "30"
LAYERDEPENDS_my-custom-bsp = "standard-edition"
LAYERSERIES_COMPAT_my-custom-bsp = "${LAYERSERIES_COMPAT_standard-edition}"
 
LAYERDIR_my-custom-bsp = "${LAYERDIR}"
 
# This should only be incremented on significant changes that will
# cause compatibility issues with other layers
LAYERVERSION_my-custom-bsp = "1"
```

## my-custom-bsp/conf/machine/industrial-pc.conf
```bitbake
require ${STANDARD_EDITION}/conf/machine/industrial-pc.conf
 
CUSTOM_KERNEL = "sokol"
```
